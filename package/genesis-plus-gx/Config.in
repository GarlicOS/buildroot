## package/genesis-plus-gx/Config.in
```kconfig
menuconfig BR2_PACKAGE_GENESIS_PLUS_GX
	bool "genesis-plus-gx"
	depends on BR2_PACKAGE_RETROARCH
	help
	  libretro implementation of genesis-plus-gx
```

## package/gpsp/Config.in
```kconfig
menuconfig BR2_PACKAGE_GPSP
	bool "gpsp"
	depends on BR2_PACKAGE_RETROARCH
	help
	  libretro implementation of gpsp
```

## package/gw/Config.in
```kconfig
menuconfig BR2_PACKAGE_GW
	bool "gw"
	depends on BR2_PACKAGE_RETROARCH
	help
	  libretro implementation of gw
```

## package/handy/Config.in
```kconfig
menuconfig BR2_PACKAGE_HANDY
	bool "handy"
	depends on BR2_PACKAGE_RETROARCH
	help
	  libretro implementation of handy
```

## package/hatari/Config.in
```kconfig
menuconfig BR2_PACKAGE_HATARI
	bool "hatari"
	depends on BR2_PACKAGE_RETROARCH
	help
	  libretro implementation of hatari
```

## package/icofont/Config.in
```kconfig
config BR2_PACKAGE_ICOFONT
	bool "icofont"
	help
	  Icofont is a freely available icon font.

	  https://icofont.com
```

## package/mame2000/Config.in
```kconfig
menuconfig BR2_PACKAGE_MAME2000
	bool "mame2000"
	depends on BR2_PACKAGE_RETROARCH
	help
	  libretro implementation of mame2000
```

## package/mame2003-xtreme/Config.in
```kconfig
menuconfig BR2_PACKAGE_MAME2003_XTREME
	bool "mame2003-xtreme"
	depends on BR2_PACKAGE_RETROARCH
	help
	  libretro implementation of mame2003-xtreme
```

## package/melonds/Config.in
```kconfig
menuconfig BR2_PACKAGE_MELONDS
	bool "melonds"
	depends on BR2_PACKAGE_RETROARCH
	help
	  libretro implementation of melonds
```

## package/mgba/Config.in
```kconfig
menuconfig BR2_PACKAGE_MGBA
	bool "mgba"
	depends on BR2_PACKAGE_RETROARCH
	help
	  libretro implementation of mgba
```

## package/mupen64plus-nx/Config.in
```kconfig
menuconfig BR2_PACKAGE_MUPEN64PLUS_NX
	bool "mupen64plus-nx"
	depends on BR2_PACKAGE_RETROARCH
	help
	  libretro implementation of mupen64plus-nx
```

## package/nekop2/Config.in
```kconfig
menuconfig BR2_PACKAGE_NEKOP2
	bool "nekop2"
	depends on BR2_PACKAGE_RETROARCH
	help
	  libretro implementation of nekop2
```

## package/neocd/Config.in
```kconfig
menuconfig BR2_PACKAGE_NEOCD
	bool "neocd"
	depends on BR2_PACKAGE_RETROARCH
	help
	  libretro implementation of neocd
```

## package/nestopia/Config.in
```kconfig
menuconfig BR2_PACKAGE_NESTOPIA
	bool "nestopia"
	depends on BR2_PACKAGE_RETROARCH
	help
	  libretro implementation of nestopia
```

## package/ngp/Config.in
```kconfig
menuconfig BR2_PACKAGE_NGP
	bool "ngp"
	depends on BR2_PACKAGE_RETROARCH
	help
	  libretro implementation of ngp
```

## package/noto-sans/Config.in
```kconfig
config BR2_PACKAGE_NOTO_SANS
	bool "noto-sans"
	help
	  Noto is a global font collection for writing in all modern and ancient languages.

	  https://fonts.google.com/specimen/Noto+Sans
```

## package/o2em/Config.in
```kconfig
menuconfig BR2_PACKAGE_O2EM
	bool "o2em"
	depends on BR2_PACKAGE_RETROARCH
	help
	  libretro implementation of o2em
```

## package/opera/Config.in
```kconfig
menuconfig BR2_PACKAGE_OPERA
	bool "opera"
	depends on BR2_PACKAGE_RETROARCH
	help
	  libretro implementation of opera
```

## package/oswald/Config.in
```kconfig
config BR2_PACKAGE_OSWALD
	bool "oswald"
	help
	  Oswald is a natural-width font family by Vernon Adams, Kalapi Gajjar & Cyreal.

	  https://fonts.google.com/specimen/Oswald
```

## package/parallel-n64/Config.in
```kconfig
menuconfig BR2_PACKAGE_PARALLEL_N64
	bool "parallel-n64"
	depends on BR2_PACKAGE_RETROARCH
	depends on BR2_PACKAGE_MESA3D
	help
	  libretro implementation of parallel-n64
```

## package/pce-fast/Config.in
```kconfig
menuconfig BR2_PACKAGE_PCE_FAST
	bool "pce-fast"
	depends on BR2_PACKAGE_RETROARCH
	help
	  libretro implementation of pce-fast
```

## package/pcfx/Config.in
```kconfig
menuconfig BR2_PACKAGE_PCFX
	bool "pcfx"
	depends on BR2_PACKAGE_RETROARCH
	help
	  libretro implementation of pcfx
```

## package/pcsx-rearmed/Config.in
```kconfig
menuconfig BR2_PACKAGE_PCSX_REARMED
	bool "pcsx-rearmed"
	depends on BR2_PACKAGE_RETROARCH
	help
	  libretro implementation of pcsx-rearmed
```

## package/picodrive/Config.in
```kconfig
menuconfig BR2_PACKAGE_PICODRIVE
	bool "picodrive"
	depends on BR2_PACKAGE_RETROARCH
	help
	  libretro implementation of picodrive
```

## package/pokemini/Config.in
```kconfig
menuconfig BR2_PACKAGE_POKEMINI
	bool "pokemini"
	depends on BR2_PACKAGE_RETROARCH
	help
	  libretro implementation of pokemini
```
