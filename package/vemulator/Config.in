## package/vemulator/Config.in
```kconfig
menuconfig BR2_PACKAGE_VEMULATOR
	bool "vemulator"
	depends on BR2_PACKAGE_RETROARCH
	help
	  libretro implementation of vemulator
```

## package/vice/Config.in
```kconfig
menuconfig BR2_PACKAGE_VICE
	bool "vice"
	depends on BR2_PACKAGE_RETROARCH
	help
	  libretro implementation of vice
```

## package/virtualjaguar/Config.in
```kconfig
menuconfig BR2_PACKAGE_VIRTUALJAGUAR
	bool "virtualjaguar"
	depends on BR2_PACKAGE_RETROARCH
	help
	  libretro implementation of virtualjaguar
```

## package/wswan/Config.in
```kconfig
menuconfig BR2_PACKAGE_WSWAN
	bool "wswan"
	depends on BR2_PACKAGE_RETROARCH
	help
	  libretro implementation of wswan
```

## package/x1/Config.in
```kconfig
menuconfig BR2_PACKAGE_X1
	bool "x1"
	depends on BR2_PACKAGE_RETROARCH
	help
	  libretro implementation of x1
```
