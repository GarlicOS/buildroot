## Config.in
```kconfig
menu "Boot scripts"
	source "$BR2_EXTERNAL_GARLIC_OS_PATH/package/bootscript/Config.in"
endmenu

menu "User interfaces"
	source "$BR2_EXTERNAL_GARLIC_OS_PATH/package/garlicui/Config.in"
endmenu

menu "Gamepad providers"
	source "$BR2_EXTERNAL_GARLIC_OS_PATH/package/gamepad/Config.in"
endmenu

menu "Emulators"
	source "$BR2_EXTERNAL_GARLIC_OS_PATH/package/retroarch/Config.in"
	source "$BR2_EXTERNAL_GARLIC_OS_PATH/package/retroarch-sdl2/Config.in"
	menu "Cores"
		source "$BR2_EXTERNAL_GARLIC_OS_PATH/package/81/Config.in"
		source "$BR2_EXTERNAL_GARLIC_OS_PATH/package/a5200/Config.in"
		source "$BR2_EXTERNAL_GARLIC_OS_PATH/package/arduous/Config.in"
		source "$BR2_EXTERNAL_GARLIC_OS_PATH/package/atari800/Config.in"
		source "$BR2_EXTERNAL_GARLIC_OS_PATH/package/bluemsx/Config.in"
		source "$BR2_EXTERNAL_GARLIC_OS_PATH/package/crocods/Config.in"
		source "$BR2_EXTERNAL_GARLIC_OS_PATH/package/dosbox-pure/Config.in"
		source "$BR2_EXTERNAL_GARLIC_OS_PATH/package/fake08/Config.in"
		source "$BR2_EXTERNAL_GARLIC_OS_PATH/package/fbalpha2012/Config.in"
		source "$BR2_EXTERNAL_GARLIC_OS_PATH/package/fbalpha2012-neogeo/Config.in"
		source "$BR2_EXTERNAL_GARLIC_OS_PATH/package/fbneo/Config.in"
		source "$BR2_EXTERNAL_GARLIC_OS_PATH/package/fceumm/Config.in"
		source "$BR2_EXTERNAL_GARLIC_OS_PATH/package/freechaf/Config.in"
		source "$BR2_EXTERNAL_GARLIC_OS_PATH/package/freeintv/Config.in"
		source "$BR2_EXTERNAL_GARLIC_OS_PATH/package/fuse/Config.in"
		source "$BR2_EXTERNAL_GARLIC_OS_PATH/package/gambatte/Config.in"
		source "$BR2_EXTERNAL_GARLIC_OS_PATH/package/gearsystem/Config.in"
		source "$BR2_EXTERNAL_GARLIC_OS_PATH/package/genesis-plus-gx/Config.in"
		source "$BR2_EXTERNAL_GARLIC_OS_PATH/package/gpsp/Config.in"
		source "$BR2_EXTERNAL_GARLIC_OS_PATH/package/gw/Config.in"
		source "$BR2_EXTERNAL_GARLIC_OS_PATH/package/handy/Config.in"
		source "$BR2_EXTERNAL_GARLIC_OS_PATH/package/hatari/Config.in"
		source "$BR2_EXTERNAL_GARLIC_OS_PATH/package/mame2000/Config.in"
		source "$BR2_EXTERNAL_GARLIC_OS_PATH/package/mame2003-xtreme/Config.in"
		source "$BR2_EXTERNAL_GARLIC_OS_PATH/package/mgba/Config.in"
		source "$BR2_EXTERNAL_GARLIC_OS_PATH/package/mupen64plus-nx/Config.in"
		source "$BR2_EXTERNAL_GARLIC_OS_PATH/package/nekop2/Config.in"
		source "$BR2_EXTERNAL_GARLIC_OS_PATH/package/neocd/Config.in"
		source "$BR2_EXTERNAL_GARLIC_OS_PATH/package/nestopia/Config.in"
		source "$BR2_EXTERNAL_GARLIC_OS_PATH/package/ngp/Config.in"
		source "$BR2_EXTERNAL_GARLIC_OS_PATH/package/o2em/Config.in"
		source "$BR2_EXTERNAL_GARLIC_OS_PATH/package/opera/Config.in"
		source "$BR2_EXTERNAL_GARLIC_OS_PATH/package/pce-fast/Config.in"
		source "$BR2_EXTERNAL_GARLIC_OS_PATH/package/pcfx/Config.in"
		source "$BR2_EXTERNAL_GARLIC_OS_PATH/package/pcsx-rearmed/Config.in"
		source "$BR2_EXTERNAL_GARLIC_OS_PATH/package/picodrive/Config.in"
		source "$BR2_EXTERNAL_GARLIC_OS_PATH/package/pokemini/Config.in"
		source "$BR2_EXTERNAL_GARLIC_OS_PATH/package/potator/Config.in"
		source "$BR2_EXTERNAL_GARLIC_OS_PATH/package/prboomlr/Config.in"
		source "$BR2_EXTERNAL_GARLIC_OS_PATH/package/prosystem/Config.in"
		source "$BR2_EXTERNAL_GARLIC_OS_PATH/package/puae2021/Config.in"
		source "$BR2_EXTERNAL_GARLIC_OS_PATH/package/px68k/Config.in"
		source "$BR2_EXTERNAL_GARLIC_OS_PATH/package/quasi88/Config.in"
		source "$BR2_EXTERNAL_GARLIC_OS_PATH/package/sameduck/Config.in"
		source "$BR2_EXTERNAL_GARLIC_OS_PATH/package/scummvm/Config.in"
		source "$BR2_EXTERNAL_GARLIC_OS_PATH/package/snes9x/Config.in"
		source "$BR2_EXTERNAL_GARLIC_OS_PATH/package/snes9x2002/Config.in"
		source "$BR2_EXTERNAL_GARLIC_OS_PATH/package/snes9x2005/Config.in"
		source "$BR2_EXTERNAL_GARLIC_OS_PATH/package/snes9x2010/Config.in"
		source "$BR2_EXTERNAL_GARLIC_OS_PATH/package/stella2014/Config.in"
		source "$BR2_EXTERNAL_GARLIC_OS_PATH/package/supafaust/Config.in"
		source "$BR2_EXTERNAL_GARLIC_OS_PATH/package/supergrafx/Config.in"
		source "$BR2_EXTERNAL_GARLIC_OS_PATH/package/tic80/Config.in"
		source "$BR2_EXTERNAL_GARLIC_OS_PATH/package/tyrquake/Config.in"
		source "$BR2_EXTERNAL_GARLIC_OS_PATH/package/uzem/Config.in"
		source "$BR2_EXTERNAL_GARLIC_OS_PATH/package/vb/Config.in"
		source "$BR2_EXTERNAL_GARLIC_OS_PATH/package/vecx/Config.in"
		source "$BR2_EXTERNAL_GARLIC_OS_PATH/package/vemulator/Config.in"
		source "$BR2_EXTERNAL_GARLIC_OS_PATH/package/vice/Config.in"
		source "$BR2_EXTERNAL_GARLIC_OS_PATH/package/virtualjaguar/Config.in"
		source "$BR2_EXTERNAL_GARLIC_OS_PATH/package/wswan/Config.in"
		source "$BR2_EXTERNAL_GARLIC_OS_PATH/package/x1/Config.in"
	endmenu
endmenu

menu "Audio and video applications"
	source "$BR2_EXTERNAL_GARLIC_OS_PATH/package/audio/Config.in"
	source "$BR2_EXTERNAL_GARLIC_OS_PATH/package/display/Config.in"
	source "$BR2_EXTERNAL_GARLIC_OS_PATH/package/fira-sans/Config.in"
	source "$BR2_EXTERNAL_GARLIC_OS_PATH/package/icofont/Config.in"
	source "$BR2_EXTERNAL_GARLIC_OS_PATH/package/noto-sans/Config.in"
	source "$BR2_EXTERNAL_GARLIC_OS_PATH/package/oswald/Config.in"
	source "$BR2_EXTERNAL_GARLIC_OS_PATH/package/roboto/Config.in"
endmenu
```

## configs/garlicos_mipsel_defconfig
```kconfig
# Architecture
BR2_mipsel=y
BR2_cortex_a53=y
BR2_MIPS_FP32_MODE_32=y
BR2_MIPS_SOFT_FLOAT=n
BR2_PIC_PIE=n
BR2_RELRO_NONE=y
BR2_PACKAGE_LUAJIT_ARCH_SUPPORTS=y
BR2_PACKAGE_JPEG_TURBO=y

# Debug
BR2_ENABLE_DEBUG=y
BR2_ENABLE_RUNTIME_DEBUG=y
BR2_DEBUG_3=y
BR2_OPTIMIZE_G=y
BR2_ENABLE_LTO=y
BR2_STRIP_strip=n
BR2_GDB_VERSION="11.2"
BR2_PACKAGE_GDB=y
BR2_PACKAGE_GDB_DEBUGGER=y
BR2_PACKAGE_STRACE=y
BR2_PACKAGE_VALGRIND=y

# Audio
BR2_PACKAGE_TINYALSA=y
BR2_PACKAGE_TINYALSA_TOOLS=y

# Cores
BR2_PACKAGE_81=y
BR2_PACKAGE_A5200=y
BR2_PACKAGE_ARDUOUS=y
BR2_PACKAGE_ATARI800=y
BR2_PACKAGE_BLUEMSX=y
BR2_PACKAGE_CROCODS=y
BR2_PACKAGE_DOSBOX_PURE=y
BR2_PACKAGE_FAKE08=y
BR2_PACKAGE_FBALPHA2012=y
BR2_PACKAGE_FBALPHA2012_NEOGEO=y
BR2_PACKAGE_FBNEO=y
BR2_PACKAGE_FCEUMM=y
BR2_PACKAGE_FREECHAF=y
BR2_PACKAGE_FREEINTV=y
BR2_PACKAGE_FUSE=y
BR2_PACKAGE_GAMBATTE=y
BR2_PACKAGE_GEARSYSTEM=y
BR2_PACKAGE_GENESIS_PLUS_GX=y
BR2_PACKAGE_GPSP=y
BR2_PACKAGE_GW=y
BR2_PACKAGE_HANDY=y
BR2_PACKAGE_HATARI=y
BR2_PACKAGE_MAME2000=y
BR2_PACKAGE_MAME2003_XTREME=y
BR2_PACKAGE_MGBA=y
BR2_PACKAGE_MUPEN64PLUS_NX=y
BR2_PACKAGE_NEKOP2=y
BR2_PACKAGE_NEOCD=y
BR2_PACKAGE_NESTOPIA=y
BR2_PACKAGE_NGP=y
BR2_PACKAGE_O2EM=y
BR2_PACKAGE_OPERA=y
BR2_PACKAGE_PCE_FAST=y
BR2_PACKAGE_PCFX=y
BR2_PACKAGE_PCSX_REARMED=y
BR2_PACKAGE_PICODRIVE=y
BR2_PACKAGE_POKEMINI=y
BR2_PACKAGE_POTATOR=y
BR2_PACKAGE_PRBOOMLR=y
BR2_PACKAGE_PROSYSTEM=y
BR2_PACKAGE_PUAE2021=y
BR2_PACKAGE_PX68K=y
BR2_PACKAGE_QUASI88=y
BR2_PACKAGE_SAMEDUCK=y
BR2_PACKAGE_SCUMMVM=y
BR2_PACKAGE_SNES9X=y
BR2_PACKAGE_SNES9X2002=y
BR2_PACKAGE_SNES9X2005=y
BR2_PACKAGE_SNES9X2010=y
BR2_PACKAGE_STELLA2014=y
BR2_PACKAGE_SUPAFAUST=y
BR2_PACKAGE_SUPERGRAFX=y
BR2_PACKAGE_TIC80=y
BR2_PACKAGE_TYRQUAKE=y
BR2_PACKAGE_UZEM=y
BR2_PACKAGE_VB=y
BR2_PACKAGE_VECX=y
BR2_PACKAGE_VEMULATOR=y
BR2_PACKAGE_VICE=y
BR2_PACKAGE_VIRTUALJAGUAR=y
BR2_PACKAGE_WSWAN=y
BR2_PACKAGE_X1=y

# Display
BR2_PACKAGE_MESA3D=y
BR2_PACKAGE_MESA3D_GALLIUM_DRIVER_SWRAST=y
BR2_PACKAGE_MESA3D_OSMESA_GALLIUM=y
BR2_PACKAGE_MESA3D_OPENGL_EGL=y
BR2_PACKAGE_MESA3D_OPENGL_ES=y
BR2_PACKAGE_SDL2=y
BR2_PACKAGE_SDL2_KMSDRM=y
BR2_PACKAGE_SDL2_OPENGLES=y
BR2_PACKAGE_SDL2_GFX=y
BR2_PACKAGE_SDL2_IMAGE=y
BR2_PACKAGE_SDL2_MIXER=y
BR2_PACKAGE_SDL2_NET=y
BR2_PACKAGE_SDL2_TTF=y

# Filesystem
BR2_ROOTFS_DEVICE_CREATION_DYNAMIC_EUDEV=y
BR2_TARGET_ROOTFS_F2FS=y
BR2_TARGET_ROOTFS_F2FS_LABEL="rootfs"
BR2_TARGET_ROOTFS_F2FS_SIZE="2048M"
BR2_TARGET_ROOTFS_TAR=n

# Fonts
BR2_PACKAGE_FIRA_SANS=y
BR2_PACKAGE_NOTO_SANS=y
BR2_PACKAGE_OSWALD=y

# GarlicOS
BR2_PACKAGE_AUDIO=y
BR2_PACKAGE_BOOTSCRIPT=y
BR2_PACKAGE_DISPLAY=y
BR2_PACKAGE_GARLICUI=y
BR2_PACKAGE_GAMEPAD=y

# Host
BR2_PACKAGE_HOST_E2FSPROGS=y
BR2_PACKAGE_HOST_RUST=y

# Locale
BR2_ENABLE_LOCALE_PURGE=n
BR2_GENERATE_LOCALE="af_ZA am_ET bg_BG ca_ES cs_CZ da_DK de_DE el_GR en_US es_ES et_EE fi_FI fil_PH fr_FR he_IL hi_IN hr_HR hu_HU id_ID is_IS it_IT ja_JP ko_KR lt_LT lv_LV ms_MY nb_NO nl_NL pl_PL pt_BR pt_PT ro_RO ru_RU sk_SK sl_SI sr_RS sv_SE sw_KE th_TH tr_TR uk_UA vi_VN zh_CN zh_TW zu_ZA"
BR2_SYSTEM_ENABLE_NLS=y
BR2_TARGET_TZ_INFO=y
BR2_TARGET_LOCALTIME="Etc/GMT+0"

# Network
BR2_PACKAGE_WIRELESS_REGDB=y
BR2_PACKAGE_WIRELESS_TOOLS=y
BR2_PACKAGE_WIRELESS_TOOLS_LIB=y
BR2_PACKAGE_WPA_SUPPLICANT=y

# Toolchain
BR2_KERNEL_HEADERS_5_4=y
BR2_PACKAGE_GLIBC_KERNEL_COMPAT=y
BR2_BINUTILS_VERSION_2_39_X=y
BR2_GCC_VERSION_12_X=y
BR2_TOOLCHAIN_BUILDROOT_CXX=y
BR2_INSTALL_LIBSTDCPP=y

# Utilities
BR2_PACKAGE_CURLPP=y
BR2_PACKAGE_DROPBEAR=y
BR2_PACKAGE_DROPBEAR_CLIENT=n
BR2_PACKAGE_KODI_PLATFORM_SUPPORTS=y
BR2_PACKAGE_KODI_PLATFORM_SUPPORTS_GBM=y
BR2_PACKAGE_LIBCURL=y
BR2_PACKAGE_MPV_SUPPORTS_VAAPI=y
```

## package/81/Config.in
```kconfig
menuconfig BR2_PACKAGE_81
	bool "81"
	depends on BR2_PACKAGE_RETROARCH
	help
	  libretro implementation of 81
```

## package/a5200/Config.in
```kconfig
menuconfig BR2_PACKAGE_A5200
	bool "a5200"
	depends on BR2_PACKAGE_RETROARCH
	help
	  libretro implementation of a5200
```

## package/arduous/Config.in
```kconfig
menuconfig BR2_PACKAGE_ARDUOUS
	bool "arduous"
	depends on BR2_PACKAGE_RETROARCH
	help
	  libretro implementation of arduous
```

## package/atari800/Config.in
```kconfig
menuconfig BR2_PACKAGE_ATARI800
	bool "atari800"
	depends on BR2_PACKAGE_RETROARCH
	help
	  libretro implementation of atari800
```

## package/audio/Config.in
```kconfig
menuconfig BR2_PACKAGE_AUDIO
	bool "Universal Audio Provider"
	help
	  Initializes soundcards and controls audio routes
```

## package/bluemsx/Config.in
```kconfig
menuconfig BR2_PACKAGE_BLUEMSX
	bool "bluemsx"
	depends on BR2_PACKAGE_RETROARCH
	help
	  libretro implementation of bluemsx
```

## package/bootscript/Config.in
```kconfig
menuconfig BR2_PACKAGE_BOOTSCRIPT
	bool "GarlicOS boot script"
	select BR2_PACKAGE_GARLICUI
	help
	  The GarlicOS boot script
```

## package/crocods/Config.in
```kconfig
menuconfig BR2_PACKAGE_CROCODS
	bool "crocods"
	depends on BR2_PACKAGE_RETROARCH
	help
	  libretro implementation of crocods
```

## package/display/Config.in
```kconfig
menuconfig BR2_PACKAGE_DISPLAY
	bool "Universal Display Provider"
	help
	  Initializes external displays and controls display routes
```

## package/dosbox-pure/Config.in
```kconfig
menuconfig BR2_PACKAGE_DOSBOX_PURE
	bool "dosbox-pure"
	depends on BR2_PACKAGE_RETROARCH
	help
	  libretro implementation of dosbox-pure
```

## package/egltest/Config.in
```kconfig
menuconfig BR2_PACKAGE_EGLTEST
	bool "EGL Test Application"
	help
	  Provides an easy to use testing interface for hardware acceleration
```

## package/fake08/Config.in
```kconfig
menuconfig BR2_PACKAGE_FAKE08
	bool "fake08"
	depends on BR2_PACKAGE_RETROARCH
	help
	  libretro implementation of fake08
```

## package/fbalpha2012-neogeo/Config.in
```kconfig
menuconfig BR2_PACKAGE_FBALPHA2012_NEOGEO
	bool "fbalpha2012-neogeo"
	depends on BR2_PACKAGE_RETROARCH
	help
	  libretro implementation of fbalpha2012-neogeo
```

## package/fbalpha2012/Config.in
```kconfig
menuconfig BR2_PACKAGE_FBALPHA2012
	bool "fbalpha2012"
	depends on BR2_PACKAGE_RETROARCH
	help
	  libretro implementation of fbalpha2012
```

## package/fbneo/Config.in
```kconfig
menuconfig BR2_PACKAGE_FBNEO
	bool "fbneo"
	depends on BR2_PACKAGE_RETROARCH
	help
	  libretro implementation of fbneo
```

## package/fira-sans/Config.in
```kconfig
config BR2_PACKAGE_FIRA_SANS
	bool "fira-sans"
	help
	  Roboto is a natural-width font family by Carrois Apostrophe.

	  https://fonts.google.com/specimen/Fira+Sans
```

## package/freechaf/Config.in
```kconfig
menuconfig BR2_PACKAGE_FREECHAF
	bool "freechaf"
	depends on BR2_PACKAGE_RETROARCH
	help
	  libretro implementation of freechaf
```

## package/freeintv/Config.in
```kconfig
menuconfig BR2_PACKAGE_FREEINTV
	bool "freeintv"
	depends on BR2_PACKAGE_RETROARCH
	help
	  libretro implementation of freeintv
```

## package/fuse/Config.in
```kconfig
menuconfig BR2_PACKAGE_FUSE
	bool "fuse"
	depends on BR2_PACKAGE_RETROARCH
	help
	  libretro implementation of fuse
```

## package/gambatte/Config.in
```kconfig
menuconfig BR2_PACKAGE_GAMBATTE
	bool "gambatte"
	depends on BR2_PACKAGE_RETROARCH
	help
	  libretro implementation of gambatte
```

## package/gamepad/Config.in
```kconfig
menuconfig BR2_PACKAGE_GAMEPAD
	bool "Universal Gamepad Provider"
	help
	  Maps multiple input devices into a single internal gamepad
```

## package/garlicui/Config.in
```kconfig
menuconfig BR2_PACKAGE_GARLICUI
	bool "Garlic User Interface"
	select BR2_PACKAGE_SDL
	select BR2_PACKAGE_SDL_KMSDRM
	select BR2_PACKAGE_SDL_GFX
	select BR2_PACKAGE_SDL_IMAGE
	select BR2_PACKAGE_SDL_IMAGE_BMP
	select BR2_PACKAGE_SDL_IMAGE_JPEG
	select BR2_PACKAGE_SDL_IMAGE_PNG
	select BR2_PACKAGE_SDL_MIXER
	select BR2_PACKAGE_SDL_NET
	select BR2_PACKAGE_SDL_SOUND
	select BR2_PACKAGE_SDL_SOUND_PLAYSOUND
	select BR2_PACKAGE_SDL_TTF
	select BR2_PACKAGE_RETROARCH
	select BR2_PACKAGE_RETROARCH_FFMPEG
	select BR2_PACKAGE_RETROARCH_SDL
	select BR2_PACKAGE_RETROARCH_RGUI_MENU
	help
	  Provides the Garlic user interface
```

## package/gearsystem/Config.in
```kconfig
menuconfig BR2_PACKAGE_GEARSYSTEM
	bool "gearsystem"
	depends on BR2_PACKAGE_RETROARCH
	help
	  libretro implementation of gearsystem
```
